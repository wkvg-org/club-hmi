## module/Kconfig
```kconfig
# SPDX-License-Identifier: Apache-2.0

rsource "drivers/display/Kconfig"
rsource "drivers/input/Kconfig"
```

## module/boards/waveshare/esp32p4_nano/Kconfig
```kconfig
# SPDX-License-Identifier: Apache-2.0

config HEAP_MEM_POOL_ADD_SIZE_BOARD
	int
	default 4096 if BOARD_WAVESHARE_ESP32P4_NANO_ESP32P4_HPCORE
```

## module/boards/waveshare/esp32p4_nano/board.yml
```yaml
board:
  name: waveshare_esp32p4_nano
  full_name: Waveshare ESP32-P4-NANO
  vendor: waveshare
  socs:
  - name: esp32p4
```

## module/drivers/display/Kconfig
```kconfig
# SPDX-License-Identifier: Apache-2.0

config JD9365
	bool "Jadard JD9365 MIPI-DSI display controller"
	default y
	depends on DT_HAS_JADARD_JD9365_ENABLED
	select MIPI_DSI
	help
	  Enable the JD9365 MIPI-DSI panel driver, as used on the Waveshare
	  10.1" DSI touch panel.

config WAVESHARE_PANEL_CTL
	bool "Waveshare panel power-sequencing and backlight controller"
	default y
	depends on DT_HAS_WAVESHARE_PANEL_CTL_ENABLED
	depends on I2C
	help
	  Enable the I2C power-sequencing and backlight driver for the small
	  on-board controller found on Waveshare MIPI-DSI touch panels.
```

## module/drivers/input/Kconfig
```kconfig
# SPDX-License-Identifier: Apache-2.0

config INPUT_WAVESHARE_GT911
	bool "Waveshare GT911 polled touch controller"
	default y
	depends on DT_HAS_WAVESHARE_GT911_ENABLED
	select I2C
	select INPUT_TOUCH
	help
	  Polled GT911 touch driver for the Waveshare ESP32-P4-NANO 10.1"
	  DSI display (the board does not route the GT911 INT/RST pins).
```

## module/drivers/mipi_dsi/Kconfig
```kconfig
# SPDX-License-Identifier: Apache-2.0

config MIPI_DSI_ESP32
	bool "Espressif ESP32-P4 MIPI-DSI Host Controller"
	default y
	depends on DT_HAS_ESPRESSIF_ESP_MIPI_DSI_ENABLED
	depends on SOC_SERIES_ESP32P4
	select MIPI_DSI
	select REGULATOR
	help
	  Enable the MIPI-DSI host + bridge controller driver for the
	  Espressif ESP32-P4. Provides the mipi_dsi_driver_api (attach and
	  LP command transfer) used by DSI panel drivers; the actual
	  framebuffer/DMA scan-out is handled by a separate
	  espressif,esp32-mipi-dsi-dpi device (see drivers/display).
```

## module/dts/bindings/display/espressif,esp32-mipi-dsi-dpi.yaml
```yaml
description: |
  Espressif ESP32-P4 MIPI DSI DPI/framebuffer scan-out engine.

  Owns a system-memory (PSRAM) framebuffer and a dedicated DW-GDMA channel
  that continuously scans it, via a single self-referencing circular
  link-list node, into the DSI bridge's push FIFO. This is the
  "zephyr,display" chosen device: it implements the Zephyr display API
  (write/blanking) used by LVGL.

  This is deliberately a separate top-level node from "espressif,esp-mipi-dsi"
  (not a child on the DSI bus): it is not a DSI peripheral, it is the video
  source that the DSI host/bridge consumes once the panel (a DSI bus child of
  the host node) attaches and switches the host into video mode.

compatible: "espressif,esp32-mipi-dsi-dpi"

include: base.yaml

properties:
  reg:
    required: true
    description: DSI bridge register bank (same physical range as the
      "bridge" reg-name entry on the sibling espressif,esp-mipi-dsi node).

  width:
    type: int
    required: true
    description: Framebuffer width in pixels.

  height:
    type: int
    required: true
    description: Framebuffer height in pixels.

  pixel-format:
    type: int
    required: true
    description: |
      Pixel format, using the MIPI_DSI_PIXFMT_* values from
      dt-bindings/mipi_dsi/mipi_dsi.h. Only MIPI_DSI_PIXFMT_RGB565 is
      currently supported by the driver.
```

## module/dts/bindings/display/jadard,jd9365.yaml
```yaml
description: |
  Jadard JD9365 MIPI-DSI TFT panel controller, as used on the Waveshare
  10.1" DSI touch panel for the ESP32-P4-NANO board (800x1280, 2 data lanes).

compatible: "jadard,jd9365"

include: [mipi-dsi-device.yaml, display-controller.yaml]

properties:
  rotation:
    type: int
    default: 0
    enum:
      - 0
      - 90
      - 180
      - 270
    description: Display rotation (CW) in degrees.
```

## module/dts/bindings/display/waveshare,panel-ctl.yaml
```yaml
description: |
  Waveshare on-panel power-sequencing and backlight controller, found on the
  10.1" MIPI-DSI touch panel used with the ESP32-P4-NANO board. This is a
  small on-board microcontroller reachable over I2C (not a display bridge
  chip): register 0x95 sequences the panel's power rails, register 0x96
  controls backlight brightness (0-255).

compatible: "waveshare,panel-ctl"

include: [i2c-device.yaml]
```

## module/dts/bindings/input/waveshare,gt911.yaml
```yaml
# Copyright (c) 2026 club-display
# SPDX-License-Identifier: Apache-2.0

description: |
  Goodix GT911 capacitive touch controller on the Waveshare 10.1" DSI
  display, polled via I2C. This variant of the board does not route the
  GT911 INT/RST pins, so the controller is polled periodically instead of
  interrupt-driven.

compatible: "waveshare,gt911"

include: [i2c-device.yaml, touchscreen-common.yaml]
```

## module/dts/bindings/mipi-dsi/espressif,esp-mipi-dsi.yaml
```yaml
description: |
  Espressif ESP32-P4 MIPI DSI host + bridge controller.

  The "host" register bank implements the DSI protocol engine (D-PHY control,
  low-power command generator, DPI video-mode timing generator). The "bridge"
  register bank scans a system-memory framebuffer, fed by a dedicated DW-GDMA
  channel, into the host's DPI video interface. Both banks are configured
  together by this node's driver (see mipi_dsi_hal_context_t in the vendor
  HAL, which owns both register pointers).

  The actual framebuffer + DMA engine is modeled as a separate
  "espressif,esp32-mipi-dsi-dpi" node (the zephyr,display chosen device),
  since it is a logically distinct role (owns memory + DMA) even though the
  registers live in the same hardware block.

compatible: "espressif,esp-mipi-dsi"

include: mipi-dsi-host.yaml

properties:
  reg:
    required: true

  reg-names:
    required: true

  data-lanes:
    type: int
    required: true
    description: Number of DSI data lanes in use (1 or 2).

  lane-bit-rate-mbps:
    type: int
    required: true
    description: DSI D-PHY lane bit rate, in Mbps.

  dpi-clock-freq-mhz:
    type: int
    description: |
      Informational default DPI pixel clock in MHz. The panel child node's
      own timings and the lane-bit-rate are what the driver actually uses to
      program the horizontal/vertical timing registers.

  phy-supply:
    type: phandle
    description: |
      Regulator (LDO) that powers the DSI D-PHY. On ESP32-P4 this is one of
      the internal LDO channels (VO3), which must be configured for 2.5V.
```
