## CMakeLists.txt
```
# Copyright (c) 2025-2026 Wolfenbütteler Kultur- und Veranstaltungsgesellschaft gemeinnützige UG (haftungsbeschränkt)
# SPDX-License-Identifier: Apache-2.0
#
# club-hmi: bar-dashboard application for the Waveshare ESP32-P4-NANO
# 10.1" MIPI-DSI panel. See PLAN.md for the full design.
#
# The out-of-tree board (waveshare_esp32p4_nano), devicetree bindings and
# drivers all live in ./module and are wired in as a Zephyr module below,
# *before* find_package(Zephyr) runs the module/board/dts discovery.

cmake_minimum_required(VERSION 3.20.0)

list(APPEND ZEPHYR_EXTRA_MODULES ${CMAKE_CURRENT_SOURCE_DIR}/module)
list(APPEND ZEPHYR_EXTRA_MODULES ${CMAKE_CURRENT_SOURCE_DIR}/../ix-lvgl)

find_package(Zephyr REQUIRED HINTS $ENV{ZEPHYR_BASE})
project(club_hmi)

target_sources(app PRIVATE src/main.c src/display_rotation.c)

add_subdirectory(src/modules/config)
add_subdirectory(src/modules/net)
add_subdirectory(src/modules/time)
add_subdirectory(src/modules/ui)
add_subdirectory(src/modules/shell)
```

## prj.conf
```kconfig
# SPDX-License-Identifier: Apache-2.0
#
# club-hmi: bar-dashboard app for the Waveshare ESP32-P4-NANO 10.1"
# MIPI-DSI panel. See PLAN.md for the full design.
#
# The MIPI-DSI host and the DPI scan-out controller are the upstream Zephyr
# drivers (CONFIG_MIPI_DSI_ESP32, CONFIG_DISPLAY_ESP32_DSI). The board's
# remaining drivers/bindings (JD9365 panel, waveshare panel-ctl, GT911) use
# "default y depends on DT_HAS_<COMPAT>_ENABLED", so they turn themselves on
# automatically from the board's devicetree.

# Console / logging
CONFIG_LOG=y
CONFIG_LOG_MODE_IMMEDIATE=y
CONFIG_DISPLAY_LOG_LEVEL_INF=y
CONFIG_MIPI_DSI_LOG_LEVEL_INF=y

# Display subsystem (the upstream MIPI-DSI host + DSI scan-out drivers enable
# themselves from the devicetree, but the DISPLAY subsystem itself needs to
# be turned on explicitly).
CONFIG_DISPLAY=y

# The display controller owns no framebuffer of its own: the app allocates a
# portrait framebuffer and scans it out directly (see src/display_rotation.c).
CONFIG_DISPLAY_ESP32_DSI_FB_NUM=0

# Input (GT911 touch -> LVGL pointer)
CONFIG_INPUT=y
CONFIG_INPUT_LOG_LEVEL_INF=y

# PSRAM: required for the DSI framebuffer (2 MB, does not fit in the
# 768 KB internal SRAM). The hpcore user SRAM is only 384 KB (the L2
# cache takes the rest), so all large buffers live in PSRAM.
CONFIG_ESP_SPIRAM=y
CONFIG_ESP_SPIRAM_HEAP_SIZE=8388608

# Code execution: the P4 runs code from flash (XIP).
CONFIG_XIP=y

# LVGL
CONFIG_LVGL=y
CONFIG_LV_COLOR_DEPTH_16=y
CONFIG_LV_Z_VDB_SIZE=10
CONFIG_LV_DEF_REFR_PERIOD=16

# Siemens iX-inspired LVGL theme (out-of-tree module ix-lvgl).
CONFIG_LVGL_IX_THEME=y
# The VDB draw buffer lives in PSRAM (custom section); the pool stays in
# SRAM. A 4-6% VDB broke the LVGL sw-renderer (crashed in the font and
# draw-buffer paths) - keep the full 10%.
CONFIG_LV_Z_VDB_CUSTOM_SECTION=y
# CONFIG_LV_Z_MEM_POOL_SYS_HEAP is not set
CONFIG_LV_Z_MEM_POOL_HEAP_LIB_C=y
# CONFIG_LV_Z_MEM_POOL_SIZE is not set
# Only the widgets used by the dashboard UI; disabling the rest saves
# code (flash) and static data (SRAM).
CONFIG_LV_USE_ARC=y
CONFIG_LV_USE_IMAGE=y
CONFIG_LV_USE_ARCLABEL=n
CONFIG_LV_USE_CALENDAR=n
CONFIG_LV_USE_CALENDAR_HEADER_ARROW=n
CONFIG_LV_USE_CALENDAR_HEADER_DROPDOWN=n
CONFIG_LV_USE_CANVAS=n
CONFIG_LV_USE_CHART=n
CONFIG_LV_USE_CHECKBOX=n
CONFIG_LV_USE_DROPDOWN=n
CONFIG_LV_USE_KEYBOARD=y
CONFIG_LV_USE_LED=n
CONFIG_LV_USE_LIST=n
CONFIG_LV_USE_MENU=n
CONFIG_LV_USE_MSGBOX=n
CONFIG_LV_USE_ROLLER=n
CONFIG_LV_USE_SPINBOX=n
CONFIG_LV_USE_SPINNER=n
CONFIG_LV_USE_SWITCH=y
CONFIG_LV_USE_TEXTAREA=y
CONFIG_LV_USE_TABLE=n
CONFIG_LV_FONT_MONTSERRAT_16=y
CONFIG_LV_FONT_MONTSERRAT_24=y
CONFIG_LV_FONT_MONTSERRAT_48=n

# Networking: 10/100M Ethernet (onboard TLK110 PHY). The interface is
# brought up by the driver; the IPv4 config (DHCP or static) and hostname
# are applied at runtime by src/modules/net/net_config.c.
CONFIG_NETWORKING=y
CONFIG_NET_L2_ETHERNET=y
CONFIG_NET_IPV4=y
CONFIG_NET_IPV6=n
CONFIG_NET_TCP=y
CONFIG_NET_SOCKETS=y
CONFIG_POSIX_API=y
CONFIG_NET_DHCPV4=y
CONFIG_NET_HOSTNAME_ENABLE=y
CONFIG_NET_HOSTNAME_DYNAMIC=y
CONFIG_NET_HOSTNAME="bar-dashboard"
CONFIG_NET_CONFIG_AUTO_INIT=n
CONFIG_ETH_DRIVER=y
CONFIG_ETH_ESP32=y
CONFIG_NET_IF_UNICAST_IPV4_ADDR_COUNT=3
CONFIG_NET_MGMT=y
CONFIG_NET_STATISTICS=y
CONFIG_NET_LOG=y
CONFIG_NET_BUF_RX_COUNT=16
CONFIG_NET_BUF_TX_COUNT=32
CONFIG_NET_PKT_RX_COUNT=8
CONFIG_NET_PKT_TX_COUNT=16

# NTP (SNTP)
CONFIG_SNTP=y

# Zbus — message bus for DMX commands (UI → MQTT)
CONFIG_ZBUS=y

# MQTT
CONFIG_MQTT_LIB=y
CONFIG_MQTT_CLEAN_SESSION=y

# HTTP client + TLS (Directus over HTTPS, insecure mode like the Arduino)
CONFIG_HTTP_CLIENT=y
CONFIG_NET_SOCKETS_SOCKOPT_TLS=y
CONFIG_TLS_CREDENTIALS=y
CONFIG_MBEDTLS=y
CONFIG_PSA_CRYPTO=y
CONFIG_MBEDTLS_ENABLE_HEAP=y
CONFIG_MBEDTLS_HEAP_SIZE=16384
CONFIG_MBEDTLS_HEAP_CUSTOM_SECTION=y
CONFIG_MBEDTLS_SSL_PROTO_TLS1_2=y
CONFIG_MBEDTLS_KEY_EXCHANGE_ECDHE_RSA_ENABLED=y
CONFIG_MBEDTLS_KEY_EXCHANGE_ECDHE_ECDSA_ENABLED=y
CONFIG_MBEDTLS_PEM_PARSE_C=y
CONFIG_MBEDTLS_X509_CRT_PARSE_C=y
CONFIG_DNS_RESOLVER=y
CONFIG_DNS_RESOLVER_AUTO_INIT=y

# JSON (config + acts parsing)
CONFIG_JSON_LIBRARY=y

# SD card (config/creds/settings files) + FATFS
CONFIG_DISK_DRIVER_SDMMC=y
CONFIG_FILE_SYSTEM=y
CONFIG_FAT_FILESYSTEM_ELM=y
CONFIG_FS_FATFS_LFN=y

CONFIG_HEAP_MEM_POOL_SIZE=16384
CONFIG_MAIN_STACK_SIZE=32768

# ── Thread stack sizes (tuned for TCP + TLS + LVGL on P4) ────────────


# LVGL size cuts: RGB565 display, no 32-bit color formats
CONFIG_LV_DRAW_SW_SUPPORT_RGB888=n
CONFIG_LV_DRAW_SW_SUPPORT_XRGB8888=n
CONFIG_LV_DRAW_SW_SUPPORT_ARGB8888=n
CONFIG_LV_DRAW_SW_SUPPORT_ARGB8888_PREMULTIPLIED=n

# Crypto cuts: only what TLS 1.2 needs (ECDHE-ECDSA + AES-GCM + SHA-256)
CONFIG_PSA_CRYPTO_ENABLE_ALL=n
CONFIG_PSA_WANT_ALG_ECDH=y
CONFIG_PSA_WANT_ALG_ECDSA=y
CONFIG_PSA_WANT_ALG_GCM=y
CONFIG_PSA_WANT_ALG_HMAC=y
CONFIG_PSA_WANT_ALG_SHA_1=y
CONFIG_PSA_WANT_ALG_SHA_256=y
CONFIG_PSA_WANT_ALG_TLS12_PRF=y
CONFIG_PSA_WANT_ALG_RSA_PKCS1V15_SIGN=y
CONFIG_PSA_WANT_KEY_TYPE_AES=y
CONFIG_PSA_WANT_KEY_TYPE_ECC_PUBLIC_KEY=y
CONFIG_PSA_WANT_KEY_TYPE_ECC_KEY_PAIR_IMPORT=y
CONFIG_PSA_WANT_KEY_TYPE_RSA_PUBLIC_KEY=y
CONFIG_PSA_WANT_ECC_SECP_R1_256=y

# More widget cuts: unused in the bar dashboard
CONFIG_LV_USE_SCALE=n
CONFIG_LV_USE_TILEVIEW=n
CONFIG_LV_USE_WIN=n
CONFIG_LV_USE_SPAN=n
CONFIG_LV_USE_ANIMIMG=n
CONFIG_LV_USE_IMAGEBUTTON=n
CONFIG_LV_USE_BUTTONMATRIX=y
CONFIG_LV_USE_LINE=n
CONFIG_STACK_SENTINEL=y
CONFIG_ETH_ESP32_RX_THREAD_STACK_SIZE=4096
CONFIG_THREAD_NAME=y
CONFIG_NET_MGMT_EVENT_STACK_SIZE=4096
CONFIG_SYSTEM_WORKQUEUE_STACK_SIZE=8192
CONFIG_NET_TCP_WORKQ_STACK_SIZE=8192
CONFIG_NET_ARP_TABLE_SIZE=8


# Zephyr shell — interactive serial console for debugging and control
CONFIG_SHELL=y
CONFIG_SHELL_BACKEND_SERIAL=y
CONFIG_SHELL_STACK_SIZE=4096
CONFIG_KERNEL_SHELL=y
CONFIG_DEVICE_SHELL=y
```

## src/main.c
```c
/*
 * Copyright (c) 2026 club-hmi
 * SPDX-License-Identifier: Apache-2.0
 *
 * club-hmi — bar-dashboard for the Waveshare ESP32-P4-NANO 10.1"
 * MIPI-DSI panel (TLK110 Ethernet, GT911 touch, 800x1280 portrait
 * mounted landscape @ 270° rotation).
 *
 * Architecture
 * ============
 * main() initialises the display, settings, and UI, then starts
 * three backend threads (NTP, MQTT, Directus) and enters
 * the LVGL event loop.
 *
 *   ┌──────────┐   ┌─────┐   ┌──────────┐
 *   │ NTP sync │   │ MQTT│   │ Directus │  ← backend threads
 *   │ (prio 6) │   │(prio│   │ (prio 4) │
 *   └────┬─────┘   └──┬──┘   └────┬─────┘
 *        │            │           │
 *   ┌────┴────────────┴───────────┴────┐
 *   │          Ethernet (EMAC)         │
 *   └─────────────────────────────────┘
 *        │
 *   ┌────┴────────────────────────────┐
 *   │   LVGL UI loop (main thread)    │
 *   │   • time/date display sidebar   │
 *   │   • overview / DMX tabs         │
 *   │   • settings / backlight        │
 *   └─────────────────────────────────┘
 */

#include <zephyr/device.h>
#include <zephyr/devicetree.h>
#include <zephyr/drivers/display.h>
#include <zephyr/kernel.h>
#include <zephyr/logging/log.h>
#include <stdbool.h>
#include <lvgl.h>
#include <ix_lvgl/theme.h>

#include "display_rotation.h"
#include "modules/config/bar_config.h"
#include "modules/net/directus.h"
#include "modules/net/mqtt.h"
#include "modules/net/net.h"
#include "modules/net/net_config.h"
#include "modules/time/ntp.h"
#include "modules/config/settings.h"
#include "modules/ui/ui.h"

LOG_MODULE_REGISTER(app, LOG_LEVEL_INF);

/*
 * Backend thread stacks.  Plain arrays placed in external RAM (PSRAM)
 * corrupted per-CPU state during the SNTP/DNS path on early P4 silicon,
 * so K_THREAD_STACK_DEFINE guards are used throughout.
 */
static K_THREAD_STACK_DEFINE(ntp_stack,      16384);
static K_THREAD_STACK_DEFINE(mqtt_stack,     20480);
static K_THREAD_STACK_DEFINE(directus_stack, 32768);
static struct k_thread ntp_thread;
static struct k_thread mqtt_thread;
static struct k_thread directus_thread;

int main(void)
{
	const struct device *display_dev = DEVICE_DT_GET(DT_CHOSEN(zephyr_display));
	lv_display_t *lv_disp;
	int ret;

	LOG_INF("display startup: device=%s ready=%d", display_dev->name,
		device_is_ready(display_dev));
	if (!device_is_ready(display_dev)) {
		LOG_ERR("display device not ready");
		return 0;
	}
	lv_disp = lv_display_get_default();
	if (lv_disp == NULL) {
		LOG_ERR("LVGL default display is NULL");
		return 0;
	}
	LOG_INF("display startup: LVGL display=%p resolution=%ux%u",
		lv_disp, lv_display_get_horizontal_resolution(lv_disp),
		lv_display_get_vertical_resolution(lv_disp));

	/*
	 * The 800×1280 panel is mounted landscape — render the UI in
	 * landscape (LVGL ROTATION_270 → logical 1280×800) and rotate the
	 * flushed pixels into the physical portrait framebuffer (see
	 * display_rotation.c) so content appears upright.
	 */
	lv_display_set_rotation(lv_disp, LV_DISPLAY_ROTATION_270);
	LOG_INF("display startup: LVGL rotation set to 270 degrees");
	ret = display_rotation_init(display_dev, lv_disp,
				    LV_DISPLAY_ROTATION_270);
	if (ret < 0) {
		LOG_ERR("failed to enable display rotation (%d)", ret);
		return 0;
	}

	/* Peripherals and UI */
	init_config();
	net_config_init();
	settings_load();
	LOG_INF("display startup: configured backlight=%u%%; held off until first frame",
		settings_get_backlight_percent());

	/*
	 * Install the Siemens iX-inspired dark theme before building the UI;
	 * widgets created afterwards pick it up automatically.
	 */
	lvgl_ix_theme_init(lv_display_get_default(), LVGL_IX_COLOR_SCHEME_DARK, NULL);

	ui_init_and_build();
	LOG_INF("display startup: UI construction complete");

	/*
	 * The upstream DSI host enables video mode and the bridge DPI output
	 * as part of the panel attach(), so the panel is already streaming by
	 * the time main() runs - there is no separate "unblank" step.
	 */

	/* Start backend threads (wait on net_is_up() internally) */
	net_init();
	k_thread_create(&ntp_thread, ntp_stack, K_THREAD_STACK_SIZEOF(ntp_stack),
			(k_thread_entry_t)ntp_service, NULL, NULL, NULL, 6, 0, K_NO_WAIT);
	k_thread_name_set(&ntp_thread, "ntp");
	k_thread_create(&mqtt_thread, mqtt_stack, K_THREAD_STACK_SIZEOF(mqtt_stack),
			(k_thread_entry_t)mqtt_service, NULL, NULL, NULL, 5, 0, K_NO_WAIT);
	k_thread_name_set(&mqtt_thread, "mqtt");
	k_thread_create(&directus_thread, directus_stack, K_THREAD_STACK_SIZEOF(directus_stack),
			(k_thread_entry_t)directus_service, NULL, NULL, NULL, 4, 0, K_NO_WAIT);
	k_thread_name_set(&directus_thread, "directus");

	LOG_INF("display ready, entering LVGL loop");

	/* LVGL runs cooperatively on the main thread at ~200 Hz */
	int64_t stats_start = k_uptime_get();
	uint32_t loop_count = 0;
	bool backlight_applied = false;
	while (1) {
		lv_timer_handler();
		if (!backlight_applied && display_rotation_frame_ready()) {
			settings_apply_backlight();
			backlight_applied = true;
			LOG_INF("display startup: backlight enabled after first complete frame");
		}
		loop_count++;
		if (k_uptime_get() - stats_start >= 60000) {
			LOG_INF("display health: LVGL loop alive, %u iterations/min",
				loop_count);
			loop_count = 0;
			stats_start = k_uptime_get();
		}
		k_sleep(K_MSEC(5));
	}

	return 0;
}
```

## src/display_rotation.c
```c
/*
 * Copyright (c) 2026 club-hmi
 * SPDX-License-Identifier: Apache-2.0
 *
 * Software rotation for the landscape-mounted portrait panel. See the
 * header for details.
 */

#include "display_rotation.h"

#include <string.h>

#include <zephyr/cache.h>
#include <zephyr/drivers/display.h>
#include <zephyr/kernel.h>
#include <zephyr/logging/log.h>
#include <zephyr/multi_heap/shared_multi_heap.h>

LOG_MODULE_REGISTER(display_rot, LOG_LEVEL_INF);

static const struct device *g_display;
#define ROT_FRAMEBUFFER_COUNT 2
static uint16_t *g_fb[ROT_FRAMEBUFFER_COUNT]; /* physical portrait RGB565 frames */
static uint16_t g_phys_w;
static uint16_t g_phys_h;
static lv_display_rotation_t g_rotation;
static uint8_t g_draw_fb;
static int8_t g_front_fb = -1;
static uint32_t g_flush_total;
static uint32_t g_flushes_window;
static uint32_t g_writes_window;
static uint32_t g_successful_writes_window;
static uint32_t g_write_errors_window;
static uint32_t g_write_total;
static int64_t g_stats_start;
static bool g_frame_ready;

static void log_frame_samples(const uint16_t *fb)
{
	const uint16_t background = 0x0021; /* RGB565 for theme #000609 */
	uint16_t x0 = 0;
	uint16_t xm = g_phys_w / 2U;
	uint16_t xr = g_phys_w - 1U;
	uint16_t y0 = 0;
	uint16_t ym = g_phys_h / 2U;
	uint16_t yb = g_phys_h - 1U;
	uint32_t grid_total = 0;
	uint32_t grid_non_background = 0;
	uint16_t step_x = g_phys_w / 32U;
	uint16_t step_y = g_phys_h / 32U;
	if (step_x == 0) {
		step_x = 1;
	}
	if (step_y == 0) {
		step_y = 1;
	}

	for (uint16_t y = step_y / 2U; y < g_phys_h; y += step_y) {
		for (uint16_t x = step_x / 2U; x < g_phys_w; x += step_x) {
			grid_total++;
			if (fb[y * g_phys_w + x] != background) {
				grid_non_background++;
			}
		}
	}

	LOG_INF("RGB565 samples TL=%04x T=%04x TR=%04x L=%04x C=%04x R=%04x BL=%04x B=%04x BR=%04x",
		fb[y0 * g_phys_w + x0], fb[y0 * g_phys_w + xm],
		fb[y0 * g_phys_w + xr], fb[ym * g_phys_w + x0],
		fb[ym * g_phys_w + xm], fb[ym * g_phys_w + xr],
		fb[yb * g_phys_w + x0], fb[yb * g_phys_w + xm],
		fb[yb * g_phys_w + xr]);
	LOG_INF("frame content grid: %u/%u samples differ from theme background RGB565=%04x",
		grid_non_background, grid_total, background);
}

static void rot_flush_cb(lv_display_t *disp, const lv_area_t *area, uint8_t *px_map)
{
	const uint16_t *px = (const uint16_t *)px_map;
	uint16_t w = (uint16_t)lv_area_get_width(area);
	uint16_t h = (uint16_t)lv_area_get_height(area);
	uint16_t x = (uint16_t)area->x1;
	uint16_t y = (uint16_t)area->y1;
	uint32_t flush_no = ++g_flush_total;
	uint16_t *draw_fb = g_fb[g_draw_fb];
	int ret = 0;

	if (flush_no == 1) {
		LOG_INF("first LVGL flush: area=(%d,%d)-(%d,%d), px_map=%p, %ux%u",
			area->x1, area->y1, area->x2, area->y2, px_map, w, h);
	}
	if (area->x1 < 0 || area->y1 < 0 || area->x2 >=
		    lv_display_get_horizontal_resolution(disp) ||
	    area->y2 >= lv_display_get_vertical_resolution(disp)) {
		LOG_ERR("invalid LVGL flush area: (%d,%d)-(%d,%d), logical=%ux%u",
			area->x1, area->y1, area->x2, area->y2,
			lv_display_get_horizontal_resolution(disp),
			lv_display_get_vertical_resolution(disp));
		lv_display_flush_ready(disp);
		return;
	}

	for (uint16_t dy = 0; dy < h; dy++) {
		for (uint16_t dx = 0; dx < w; dx++) {
			uint32_t fx;
			uint32_t fy;

			if (g_rotation == LV_DISPLAY_ROTATION_90) {
				fx = y + dy;
				fy = (uint32_t)(g_phys_h - 1U) - (x + dx);
			} else if (g_rotation == LV_DISPLAY_ROTATION_270) {
				fx = (uint32_t)(g_phys_w - 1U) - (y + dy);
				fy = x + dx;
			} else {
				/* Only 90/270 are supported here. */
				continue;
			}
			draw_fb[fy * g_phys_w + fx] = px[(uint32_t)dy * w + dx];
		}
	}

	if (lv_display_flush_is_last(disp)) {
		struct display_buffer_descriptor desc = {
			.buf_size = (size_t)g_phys_w * g_phys_h * 2U,
			.width = g_phys_w,
			.pitch = g_phys_w,
			.height = g_phys_h,
		};

		sys_cache_data_flush_range(draw_fb, (size_t)g_phys_w * g_phys_h * 2U);
		ret = display_write(g_display, 0, 0, &desc, draw_fb);
		g_write_total++;
		g_writes_window++;
		if (ret < 0) {
			g_write_errors_window++;
			LOG_ERR("display_write #%u failed: %d, framebuffer=%p %ux%u pitch=%u",
				flush_no, ret, draw_fb, desc.width, desc.height, desc.pitch);
		} else {
			g_successful_writes_window++;
			g_frame_ready = true;
			int8_t old_front = g_front_fb;
			g_front_fb = (int8_t)g_draw_fb;
			g_draw_fb = old_front >= 0 ? (uint8_t)old_front
							 : (uint8_t)(g_front_fb ^ 1);
			/* Seed the now-inactive buffer so later partial LVGL updates
			 * never modify the frame currently being scanned out.
			 */
			memcpy(g_fb[g_draw_fb], draw_fb,
			       (size_t)g_phys_w * g_phys_h * sizeof(*draw_fb));
			sys_cache_data_flush_range(g_fb[g_draw_fb],
					  (size_t)g_phys_w * g_phys_h * sizeof(*draw_fb));
			if (g_write_total == 1) {
				LOG_INF("first display_write succeeded: %ux%u, %zu bytes",
					desc.width, desc.height, desc.buf_size);
				log_frame_samples(draw_fb);
			}
		}
		if (k_uptime_get() - g_stats_start >= 60000) {
			LOG_INF("display output health: %u LVGL flushes/min, %u display_write calls/min, %u succeeded, %u failed (total writes=%u)",
				g_flushes_window, g_writes_window,
				g_successful_writes_window, g_write_errors_window,
				g_write_total);
			if (g_write_total > 0 && g_front_fb >= 0) {
				log_frame_samples(g_fb[(uint8_t)g_front_fb]);
			}
			g_flushes_window = 0;
			g_writes_window = 0;
			g_successful_writes_window = 0;
			g_write_errors_window = 0;
			g_stats_start = k_uptime_get();
		}
	}
	g_flushes_window++;

	lv_display_flush_ready(disp);
}

bool display_rotation_frame_ready(void)
{
	return g_frame_ready;
}

int display_rotation_init(const struct device *display, lv_display_t *lv_disp,
			  lv_display_rotation_t rotation)
{
	struct display_capabilities caps;
	size_t fb_size;

	if (rotation != LV_DISPLAY_ROTATION_90 && rotation != LV_DISPLAY_ROTATION_270) {
		LOG_ERR("unsupported rotation %d", rotation);
		return -EINVAL;
	}

	display_get_capabilities(display, &caps);
	LOG_INF("display capabilities: ready=%d resolution=%ux%u, rotation=%d",
		device_is_ready(display), caps.x_resolution, caps.y_resolution, rotation);
	g_phys_w = (uint16_t)caps.x_resolution;
	g_phys_h = (uint16_t)caps.y_resolution;
	g_rotation = rotation;
	g_display = display;

	fb_size = (size_t)g_phys_w * g_phys_h * 2U;
	for (uint8_t i = 0; i < ROT_FRAMEBUFFER_COUNT; i++) {
		g_fb[i] = shared_multi_heap_aligned_alloc(
			SMH_REG_ATTR_EXTERNAL, CONFIG_ESP32_CACHE_L2_LINE_SIZE, fb_size);
		if (g_fb[i] == NULL) {
			LOG_ERR("failed to allocate portrait framebuffer %u (%zu bytes)", i,
				fb_size);
			while (i > 0) {
				shared_multi_heap_free(g_fb[--i]);
				g_fb[i] = NULL;
			}
			return -ENOMEM;
		}
		memset(g_fb[i], 0, fb_size);
		sys_cache_data_flush_range(g_fb[i], fb_size);
	}
	g_draw_fb = 0;
	g_front_fb = -1;
	LOG_INF("allocated %u ping-pong display framebuffers: %zu bytes each at %p, %p (external RAM)",
		ROT_FRAMEBUFFER_COUNT, fb_size, g_fb[0], g_fb[1]);
	g_stats_start = k_uptime_get();

	lv_display_set_flush_cb(lv_disp, rot_flush_cb);
	LOG_INF("installed LVGL rotation flush callback: logical=%ux%u physical=%ux%u",
		lv_display_get_horizontal_resolution(lv_disp),
		lv_display_get_vertical_resolution(lv_disp), g_phys_w, g_phys_h);

	LOG_INF("software rotation %d enabled: %ux%u portrait framebuffer @ %p",
		rotation, g_phys_w, g_phys_h, (void *)g_fb);

	return 0;
}
```

## src/display_rotation.h
```c
/*
 * Copyright (c) 2026 club-hmi
 * SPDX-License-Identifier: Apache-2.0
 *
 * Software rotation for the landscape-mounted portrait panel.
 *
 * The 800x1280 panel is mounted landscape, so LVGL renders at 1280x800
 * (LV_DISPLAY_ROTATION_270) and the flush callback rotates each flushed
 * landscape tile into a physical portrait framebuffer, which is then
 * presented to the display controller for scan-out.
 */

#ifndef DISPLAY_ROTATION_H_
#define DISPLAY_ROTATION_H_

#include <stdbool.h>
#include <zephyr/device.h>
#include <lvgl.h>

/**
 * @brief Enable software rotation of the LVGL output into a portrait
 * framebuffer presented to @p display.
 *
 * @param display The zephyr,display device (espressif,esp-dsi-display).
 * @param lv_disp The LVGL display.
 * @param rotation Rotation to apply (LV_DISPLAY_ROTATION_90 or 270).
 * @return 0 on success, negative on error.
 */
int display_rotation_init(const struct device *display, lv_display_t *lv_disp,
			  lv_display_rotation_t rotation);

/**
 * @brief Return whether at least one complete frame was accepted by display_write().
 */
bool display_rotation_frame_ready(void);

#endif /* DISPLAY_ROTATION_H_ */
```
